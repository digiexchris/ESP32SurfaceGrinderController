## sdkconfig.defaults
```kconfig
CONFIG_LV_USE_USER_DATA=y
CONFIG_LV_COLOR_16_SWAP=y
CONFIG_LV_COLOR_DEPTH_16=y
CONFIG_EXAMPLE_LCD_CONTROLLER_ILI9341=y
# CONFIG_EXAMPLE_LCD_TOUCH_ENABLED=y
CONFIG_LV_BUILD_EXAMPLES=n
CONFIG_LV_USE_ILI9341=y
CONFIG_STACK_CHECK_NORM=y
CONFIG_COMPILER_CXX_EXCEPTIONS=y
CONFIG_LV_USE_OBSERVER=y
CONFIG_COMPILER_CACHE_ENABLE=y
```
